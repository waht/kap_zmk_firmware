#include "kap.dtsi"

&default_transform {
    col-offset = <5>;
};

&kscan0 {
    row-gpios
        = <&pro_micro 2 (GPIO_ACTIVE_HIGH | GPIO_PULL_DOWN)> // Row A from the schematic file
        , <&pro_micro 3 (GPIO_ACTIVE_HIGH | GPIO_PULL_DOWN)> // Row B from the schematic file
        , <&pro_micro 4 (GPIO_ACTIVE_HIGH | GPIO_PULL_DOWN)> // Row C from the schematic file
        , <&pro_micro 5 (GPIO_ACTIVE_HIGH | GPIO_PULL_DOWN)> // Row D from the schematic file
        ;

    col-gpios
        = <&pro_micro 21 GPIO_ACTIVE_HIGH> // col1 in the schematic
        , <&pro_micro 20 GPIO_ACTIVE_HIGH> // col2 in the schematic
        , <&pro_micro 19 GPIO_ACTIVE_HIGH> // col3 in the schematic
        , <&pro_micro 15 GPIO_ACTIVE_HIGH> // col4 in the schematic
        , <&pro_micro 14 GPIO_ACTIVE_HIGH> // col5 in the schematic
        ;
};
