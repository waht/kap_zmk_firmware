## config/boards/shields/kap/Kconfig.defconfig
```kconfig
if SHIELD_KAP_LEFT

config ZMK_KEYBOARD_NAME
    default "kapsplit"

config ZMK_SPLIT_ROLE_CENTRAL
    default y

endif

if SHIELD_KAP_LEFT || SHIELD_KAP_RIGHT

config ZMK_SPLIT
    default y

endif
```

## config/boards/shields/kap/Kconfig.shield
```kconfig
config SHIELD_KAP_LEFT
    def_bool $(shields_list_contains, kap_left)

config SHIELD_KAP_RIGHT
    def_bool $(shields_list_contains, kap_right)
```
